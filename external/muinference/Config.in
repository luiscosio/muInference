## external/muinference/muinference_defconfig
```kconfig
# muinference Buildroot defconfig
# Minimal x86_64 VM for SL5-style Weight Enclave GPU inference

BR2_x86_64=y
BR2_x86_corei7=y
BR2_TOOLCHAIN_BUILDROOT_GLIBC=y

# Minimal userspace with busybox
BR2_ROOTFS_DEVICE_TABLE="system/device_table.txt"
BR2_INIT_BUSYBOX=y
BR2_SYSTEM_BIN_SH_BUSYBOX=y
BR2_TARGET_GENERIC_HOSTNAME="muinference-enclave"
BR2_TARGET_GENERIC_ISSUE="muinference Weight Enclave - SL5 GPU Inference"

# Security: no root login, no SSH for minimal attack surface
BR2_TARGET_ENABLE_ROOT_LOGIN=n
BR2_PACKAGE_DROPBEAR=n

# Networking (minimal)
BR2_SYSTEM_DHCP="eth0"
BR2_PACKAGE_BUSYBOX_SHOW_OTHERS=y
BR2_PACKAGE_IPROUTE2=y
BR2_PACKAGE_IPTABLES=y

# Python for enclave server (hackathon prototype)
BR2_PACKAGE_PYTHON3=y
BR2_PACKAGE_PYTHON3_PIP=y
BR2_PACKAGE_PYTHON3_SSL=y
BR2_PACKAGE_PYTHON3_HASHLIB=y

# Python crypto dependencies
BR2_PACKAGE_PYTHON_PYCRYPTODOMEX=y

# Filesystem image
BR2_TARGET_ROOTFS_EXT2=y
BR2_TARGET_ROOTFS_EXT2_4=y
BR2_TARGET_ROOTFS_EXT2_SIZE="2G"

# Kernel configuration
BR2_LINUX_KERNEL=y
BR2_LINUX_KERNEL_USE_CUSTOM_CONFIG=y
BR2_LINUX_KERNEL_CUSTOM_CONFIG_FILE="$(BR2_EXTERNAL_MUINFERENCE_PATH)/board/x86_64/muinference/linux.config"
BR2_LINUX_KERNEL_VMLINUX=y

# Install our enclave package
BR2_PACKAGE_MUINFERENCE_ENCLAVE=y

# Rootfs overlay with server + config
BR2_ROOTFS_OVERLAY="$(BR2_EXTERNAL_MUINFERENCE_PATH)/rootfs_overlay"

# Post-build script for auto-start
BR2_ROOTFS_POST_BUILD_SCRIPT="$(BR2_EXTERNAL_MUINFERENCE_PATH)/board/x86_64/muinference/post_build.sh"
```

## external/muinference/package/muinference-enclave/Config.in
```kconfig
config BR2_PACKAGE_MUINFERENCE_ENCLAVE
	bool "muinference-enclave"
	depends on BR2_PACKAGE_PYTHON3
	help
	  Installs the enclave_server.py and minimal config into the rootfs.
	  This is the core Weight Enclave server for SL5-style GPU inference
	  with minimal attack surface.
```
